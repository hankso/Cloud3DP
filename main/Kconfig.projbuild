## main/Kconfig.projbuild
```kconfig
menu "Extra Configuration"

config BLINK_GPIO
    int "Blink GPIO number"
	range 0 34
	default 2
	help
		GPIO number (IOxx) to blink on and off.

		Some GPIOs are used for other purposes (flash connections, etc.) and cannot be used to blink.

		GPIOs 35-39 are input-only so cannot be used as outputs.

config FS_FFat
    bool "Use FAT Flash File System"
    default false
    help
        File system format used on flash.

config FS_SPIFFS
    bool "Use SPI Flash File System"
    default true
    help
        File system format used on flash.

endmenu
```
